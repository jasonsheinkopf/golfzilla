// 7/13/19

#include <DS3231.h>                       // library for RTC clock
#include <avr/pgmspace.h>                 // library to store variables to RAM
#include "RGB.h"                          // library file holding common color values
#include <Adafruit_GFX.h>                 // library for neopixel text and shapes
#include <Adafruit_NeoMatrix.h>           // library for neopixel matris
#include <Adafruit_NeoPixel.h>            // library for neopixels
#include <Adafruit_VL53L0X.h>             // library for distance sensor SDA
#include <Adafruit_ST7735.h>              // library for TFT display
#include <SPI.h>                          // library for SPI
//#include <SD.h>                           // libary for external SD card
#include <EEPROM.h>                       // library to store values in EEPROM
#include <Wire.h>                         // library for I2C
#include <Adafruit_LEDBackpack.h>         // library for LED 7 segment display
//#include "SdFat.h"                        // library for Software SPI
//#if ENABLE_SOFTWARE_SPI_CLASS             // Must be set in SdFat/SdFatConfig.h

#define DISPLAY_ADDRESS   0x70            // I2C address for 7 segment display
#define DATA_PIN 2                        // data pin for neopixels
#define arr_len( x )  ( sizeof( x ) / sizeof( *x ) )    // number of neopixels?
#define TFT_CS        53                  // TFT chip select pin
#define TFT_RST       49                  // TFT reset pin
#define TFT_DC        38                  // TFT data command pin
#define TFT_BACKLIGHT  7                  // TFT backlight pin
// TFT SCL (SCK) = 52, SDA (MOSI) = 51
#define upButton 37                       // button to increase time in room
#define dnButton 35                       // button to decrease time in room
#define timeZero 33                       // button that resets room
#define doorButton 27                     // button to open door
#define doorRelease 34                    // signal to relay to open door
#define holePin 7                         // receive pin from nano when ball in hole

Adafruit_NeoMatrix matrix = Adafruit_NeoMatrix(128, 8, DATA_PIN, // instance of matrix
                            NEO_MATRIX_TOP + NEO_MATRIX_LEFT +
                            NEO_MATRIX_COLUMNS + NEO_MATRIX_PROGRESSIVE +
                            NEO_MATRIX_ZIGZAG, NEO_GRB + NEO_KHZ800);

Adafruit_ST7735 tft = Adafruit_ST7735(TFT_CS, TFT_DC, TFT_RST); // instance of TFT
Adafruit_7segment clockDisplay = Adafruit_7segment();           //instance of 7 seg display
RTClib RTC;                               // instance of RTC

byte brightness = 100;                  // brightness of neomatrix (0-100?)
//Adafruit_VL53L0X tof = Adafruit_VL53L0X();  // create instance of TOF object
byte roomTime;                          // number of minutes in room
unsigned long startTime;                // time in seconds when ball goes in hole
int timeLeft;                           // seconds until time in room time is over
String minutes;                         // text of minutes until time in room time is over
int minutesInt;                         // in to of minutes until time in room time is over
String colon = String(":");             // ":"
String zero = String("0");              // "0"
String seconds;                         // text of seconds until time in room time is over
int secondsInt;                         // int of seconds until time in room time is over
String countdown;                       // entire text string for time left ex "8:32"
bool hole = false;                      // true after ball goes in hole
bool point = false;                     // true if point has been added to numWins
unsigned long numWins;                  // lifetime number of wins
byte redLed, greenLed, blueLed;         // variables for led color from file convesion
bool pressed = false;                   // is true when either time change button pressed
byte textDelay = 0;                     // delay between text scroll
byte timeDelay = 10;                    // delay between time scroll
byte imageDelay = 0;                    // delay between image scroll
int y = matrix.height();                // y is matrix height
int x = matrix.width();                 // x is matrix width
String pixel = "";
const uint8_t SOFT_MISO_PIN = 12;       // SD card software SPI
const uint8_t SOFT_MOSI_PIN = 11;       // SD card software SPI
const uint8_t SOFT_SCK_PIN  = 13;       // SD card software SPI
const uint8_t SD_CHIP_SELECT_PIN = 22;  // SD card software SPI

//SdFatSoftSpi<SOFT_MISO_PIN, SOFT_MOSI_PIN, SOFT_SCK_PIN> sd;  // instance of SD
//SdFile file;                            // instance of SD file

//artist image of golfzilla
const long pizilla[] PROGMEM = {
  0x000000, 0x000000, 0x000000, 0x000000, 0x000000, 0x000000, 0x000000, 0x000000, 0x000000, 0x000000, 0x000000, 0x000000,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 0x000000,
  0x000000, 0x000000, 0x000000, 0x000000, 0x000000, 0x000000, 0x000000, 0x000000, 0x000000, 0x000000, 0x000000, 0x000000,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 0x000000,
  0x000000, 0x000000, 0x000000, 0x000000, 0x000000, 0x000000, 0x000000, 0x000000, 0x000000, 0x000000, 0x000000, 0x000000,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 0x000000,
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  0x000000, 0x000000, 0x000000, 0x000000, 0x000000, 0x000000, 0x000000, 0x000000, 0x000000, 0x000000, 0x000000, 0x000000,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 0x000000
  };

void setup() {
  pinMode (upButton, INPUT_PULLUP);
  pinMode (dnButton, INPUT_PULLUP);
  pinMode (timeZero, INPUT_PULLUP);
  pinMode (doorButton, INPUT_PULLUP);
  pinMode (doorRelease, OUTPUT);
  pinMode (holePin, INPUT_PULLUP);
  Wire.begin();                           // begin SPI for RTC and 7-seg
  //sd.begin(SD_CHIP_SELECT_PIN);           // begin SD card
  matrix.begin();                         // begin matrix library
  //file.print(F("0x"));                  // upload w this 1x to make SD card work
  matrix.setTextWrap(false);              // true makes letters only appear when fully in screen
  matrix.setBrightness(brightness);       // set brightness
  matrix.setTextColor(matrix.Color(255, 100, 0));     // set text starting color orange
  Serial.begin(115200);
  tft.initR(INITR_MINI160x80);            // Init ST7735S mini display
  tft.fillScreen(ST77XX_BLACK) ;          // fill screen black
  tft.setRotation(3);                     // rotate TFT to upright
  tft.setTextSize(2);                     // set text size to 2
  tft.drawRect(2, 2, 156, 76, ST77XX_WHITE);  // create white box border
  tft.setCursor(10, 10);
  tft.setTextColor(ST77XX_WHITE);
  tft.setTextWrap(true);
  tft.print("Wins:");
  //EEPROM_writelong(0x00, 1);            // comment out after initial write
  //EEPROM_writelong(0x20, 5);            // comment out after initial write
  numWins = EEPROM_readlong(0x00);        // read numWins from EEPROM
  roomTime = EEPROM_readlong(0x20);       // read roomTime from EEPROM
  tft.setCursor(70, 10);
  tft.print(numWins);                     // print numWins to TFT
  tft.setCursor(10, 40);
  tft.print("Mins:");
  tft.setCursor(70, 40);
  tft.print(roomTime);
  clockDisplay.begin(DISPLAY_ADDRESS);    // begin 7 seg display
  resetRoomClock();                       // set 7-seg to roomTime
}

void loop() {
  //scrollText("This is a test, so deal with it!");
  //pixelDraw(2, 4, 100, 20, 0);
  //pixelColor(4, 5, red);
  //colorWipe(red, 1);
  //fillScreen(blue);
  //fadePixel(4, 5, red, green, 5, 50);
  //fadeScreen(4, 5, red, green, 10, 50);
  //fadeScreen(4, 5, green, white, 10, 50);
  //fadeScreen(4, 5, white, red, 10, 50);
  mainProgram();
  //colorConverter("0x294953");
  //scrollImage(pizilla);
  //checkButtons();
  //buttonValue();
  //Serial.println(millis());
  //drawImage(pizzaToon);
  //drawImage();
}

void resetRoomClock() {
  clockDisplay.print(roomTime * 100, DEC);
  clockDisplay.drawColon(true);
  clockDisplay.writeDisplay();
}

void mainProgram() {
  if (hole == false) {                          // sequence before hole
    scrollText("Look out, it's Godzarella!");
    scrollImage(pizilla);
    scrollText("Nothing can save us now!");
    scrollImage(pizilla);
  }
  else {                                        // sequence after hole
    if (point == false) {
      digitalWrite(doorRelease, HIGH);
      addScore();
      successScreen();
      point = true;
      digitalWrite(doorRelease, LOW);
      DateTime now = RTC.now();
      startTime = now.unixtime();        // time when ball goes in hole
    }
    scrollTimeText("Just ", " until next game!");
    scrollImageRoom(pizilla);
    scrollTimeText("Will ", " never end?");
    scrollImageRoom(pizilla);
  }
  checkButtons();
}

void sevSegTime() {
  int displayTime;
  if (timeLeft >= 60) {
    displayTime = (minutesInt * 100 + secondsInt);
    clockDisplay.print(displayTime, DEC);
    clockDisplay.drawColon(true);
  }
  else if (timeLeft < 60 && timeLeft > 30) {
    if ((millis() / 500) % 2 == 1) {
      displayTime = (minutesInt * 100 + secondsInt);
      clockDisplay.print(displayTime, DEC);
      clockDisplay.writeDigitNum(1, 0, false);
      clockDisplay.drawColon(true);
    }
    else {
      clockDisplay.writeDigitRaw(1, 0);
      clockDisplay.writeDigitRaw(2, 0);
      clockDisplay.writeDigitRaw(3, 0);
      clockDisplay.writeDigitRaw(4, 0);
      clockDisplay.drawColon(false);
    }
  }
  else if (timeLeft <= 30 && timeLeft > 15) {
    if ((millis() / 250) % 2 == 1) {
      displayTime = (minutesInt * 100 + secondsInt);
      clockDisplay.print(displayTime, DEC);
      clockDisplay.writeDigitNum(1, 0, false);
      clockDisplay.drawColon(true);
    }
    else {
      clockDisplay.writeDigitRaw(1, 0);
      clockDisplay.writeDigitRaw(2, 0);
      clockDisplay.writeDigitRaw(3, 0);
      clockDisplay.writeDigitRaw(4, 0);
      clockDisplay.drawColon(false);
    }
  }
  else if (timeLeft <= 15 && timeLeft > 5) {
    if ((millis() / 125) % 2 == 1) {
      displayTime = (minutesInt * 100 + secondsInt);
      if (timeLeft < 10) {
        clockDisplay.print(displayTime, DEC);
        clockDisplay.writeDigitNum(1, 0, false);
        clockDisplay.writeDigitRaw(3, 63);
        clockDisplay.drawColon(true);
      }
      else {
        clockDisplay.print(displayTime, DEC);
        clockDisplay.writeDigitNum(1, 0, false);
        clockDisplay.drawColon(true);
      }
    }
    else {
      clockDisplay.writeDigitRaw(1, 0);
      clockDisplay.writeDigitRaw(2, 0);
      clockDisplay.writeDigitRaw(3, 0);
      clockDisplay.writeDigitRaw(4, 0);
      clockDisplay.drawColon(false);
    }
  }
  else if (timeLeft <= 5 && timeLeft > 0) {
    if ((millis() / 62) % 2 == 1) {
      displayTime = (minutesInt * 100 + secondsInt);
      if (timeLeft < 10) {
        clockDisplay.print(displayTime, DEC);
        clockDisplay.writeDigitNum(1, 0, false);
        clockDisplay.writeDigitRaw(3, 63);
        clockDisplay.drawColon(true);
      }
      else {
        clockDisplay.print(displayTime, DEC);
        clockDisplay.writeDigitNum(1, 0, false);
        clockDisplay.drawColon(true);
      }
    }
    else {
      clockDisplay.writeDigitRaw(1, 0);
      clockDisplay.writeDigitRaw(2, 0);
      clockDisplay.writeDigitRaw(3, 0);
      clockDisplay.writeDigitRaw(4, 0);
      clockDisplay.drawColon(false);
    }
  }
  clockDisplay.writeDisplay();
}

void checkButtons() {
  if ((digitalRead(upButton) == LOW) && pressed == false && roomTime < 15) {
    tft.setCursor(70, 40);
    tft.setTextColor(ST77XX_BLACK);
    tft.print(roomTime);
    roomTime ++;
    tft.setTextColor(ST77XX_WHITE);
    tft.setCursor(70, 40);
    tft.print(roomTime);
    EEPROM_writelong(0x20, roomTime);
    pressed = true;
    resetRoomClock();
  }
  if ((digitalRead(dnButton) == LOW) && pressed == false && roomTime > 1) {
    tft.setCursor(70, 40);
    tft.setTextColor(ST77XX_BLACK);
    tft.print(roomTime);
    roomTime --;
    tft.setTextColor(ST77XX_WHITE);
    tft.setCursor(70, 40);
    tft.print(roomTime);
    EEPROM_writelong(0x20, roomTime);
    pressed = true;
    resetRoomClock();
  }
  if ((digitalRead(dnButton) == HIGH) && (digitalRead(upButton) == HIGH)) {
    pressed = false;
  }
  if (digitalRead(timeZero) == LOW && hole == true) {
    roomOver();
  }
  if (digitalRead(doorButton) == LOW && hole == false) {
    hole = true;
  }
  if (digitalRead(doorButton) == HIGH && hole == false) {
    digitalWrite(doorRelease, LOW);
  }
  if (digitalRead(doorButton) == LOW && hole == true) {
    digitalWrite(doorRelease, HIGH);
  }
  if (digitalRead(doorButton) == HIGH && hole == true) {
    digitalWrite(doorRelease, LOW);
  }
}

void addScore() {
  numWins = EEPROM_readlong(0x00);
  tft.setCursor(70, 10);
  tft.setTextColor(ST77XX_BLACK);
  tft.print(numWins);
  tft.setCursor(70, 10);
  tft.setTextColor(ST77XX_WHITE);
  numWins++;
  EEPROM_writelong(0x00, numWins);
  tft.print(numWins);

}

void successScreen() {
  fadeScreen(4, 5, red, green, 10, 50);
  fadeScreen(4, 5, green, white, 10, 50);
  fadeScreen(4, 5, white, off, 10, 50);
  fadeScreen(4, 5, off, red, 10, 50);
}

void checkDistance() {
  if (digitalRead(holePin) == LOW) {
    hole = true;
  }
}

void calculateTime() {
  //int timeCorrection = roomTime
  DateTime now = RTC.now();
  timeLeft = roomTime * 60 - (now.unixtime() - startTime);
  minutes = String(timeLeft / 60, DEC);
  minutesInt = timeLeft / 60;
  colon = String(":");
  seconds = String(timeLeft % 60, DEC);
  secondsInt = timeLeft % 60;
  if (timeLeft % 60 < 10) {
    countdown = String(minutes + colon + zero + seconds);
  }
  else {
    countdown = String(minutes + colon + seconds);
  }
  sevSegTime();
  if (timeLeft <= 0) {
    roomOver();
  }
}

void roomOver() {
  clockDisplay.writeDigitRaw(0, 57);
  clockDisplay.writeDigitRaw(1, 64);
  clockDisplay.writeDigitRaw(3, 110);
  clockDisplay.writeDigitRaw(4, 119);
  clockDisplay.drawColon(false);
  clockDisplay.writeDisplay();
  hole = false;
  scrollText("Putter up!");
  resetRoomClock();
  point = false;
}

void scrollTimeText(String before, String after) {
  int x = matrix.width();
  checkButtons();
  int pixelsInText = 9 * (sizeof(before) + sizeof(after) + sizeof(countdown))  + matrix.width();
  matrix.setCursor(x, 0);
  while (x > (matrix.width() - pixelsInText)) {
    if (hole == false) {
      break;
    }
    matrix.fillScreen(matrix.Color(off.r, off.g, off.b));
    matrix.setCursor(--x, 0);
    calculateTime();
    String textTimeText = (before + countdown + after);
    matrix.print(textTimeText);
    matrix.show();
    //delay(timeDelay);
    if (timeLeft == 0) {
      hole = false;
      return;
    }
    checkButtons();
  }
}

void scrollText(String textToDisplay) {
  if (hole == true) {
    return;
  }
  int x = matrix.width();
  int pixelsInText = textToDisplay.length() * 10 + matrix.width() / 2;
  matrix.setCursor(x, 0);
  matrix.print(textToDisplay);
  matrix.show();
  while (x > (matrix.width() - pixelsInText)) {
    matrix.fillScreen(matrix.Color(off.r, off.g, off.b));
    matrix.setCursor(--x, 0);
    matrix.print(textToDisplay);
    matrix.show();
    checkButtons();
    checkDistance();
    Serial.println(millis());
    if (hole == true) {
      break;
    }
  }
}

void fadeScreen(int x, int y, RGB startColor, RGB endColor, int steps, int wait) {
  for (int i = 0; i <= steps; i++)
  {
    int newR = startColor.r + (endColor.r - startColor.r) * i / steps;
    int newG = startColor.g + (endColor.g - startColor.g) * i / steps;
    int newB = startColor.b + (endColor.b - startColor.b) * i / steps;

    matrix.fillScreen(matrix.Color(newR, newG, newB));
    matrix.show();
    delay(wait);
  }
}

void fadePixel(int x, int y, RGB startColor, RGB endColor, int steps, int wait) {
  for (int i = 0; i <= steps; i++)
  {
    int newR = startColor.r + (endColor.r - startColor.r) * i / steps;
    int newG = startColor.g + (endColor.g - startColor.g) * i / steps;
    int newB = startColor.b + (endColor.b - startColor.b) * i / steps;

    matrix.drawPixel(x, y, matrix.Color(newR, newG, newB));
    matrix.show();
    delay(wait);
  }
}

/*void fillScreen(RGB color) {
  matrix.fillScreen(matrix.Color(color.r, color.g, color.b));
  matrix.show();
}*/

void colorWipe(RGB color, uint8_t wait) {
  for (uint16_t row = 0; row < y; row++) {
    for (uint16_t column = 0; column < x; column++) {
      matrix.drawPixel(column, row, matrix.Color(color.r, color.g, color.b));
      matrix.show();
      delay(wait);
    }
  }
}

void pixelDraw(byte x, byte y, byte r, byte g, byte b) {
  matrix.drawPixel(x, y, matrix.Color(r, g, b));
  matrix.show();
}

void pixelColor(byte x, byte y, RGB color) {
  matrix.drawPixel(x, y, matrix.Color(color.r, color.g, color.b));
  matrix.show();
}


void colorConverter(unsigned long hexValue)  {
  redLed = hexValue >> 16 ;
  greenLed = (hexValue & 0x00ff00) >> 8;
  blueLed = (hexValue & 0x0000ff);
  hexValue = 0;
  hexValue |= redLed << 16;
  hexValue |= blueLed << 8;
  hexValue |= greenLed;
}

/*/void testImage() {
  const long testing [] = {0xffffff, 0xffffff};
  colorConverter(testing [1]);
  matrix.drawPixel(0, 1, matrix.Color(redLed, greenLed, blueLed));
  matrix.show();
}
*/

/*void drawImage() {
  long pixel[128];
  char currentChar;
  String webColor;
  file.open("SoftSpi.txt", O_RDWR | O_CREAT);
  for (int y = 1; y <= 8; y++) {
    for (

    currentChar = file.read();
    if (currentChar != '\n') {
      if (currentChar != ',') {
        pixel = pixel + currentChar;
        x++;
      }
      //long pixelLong = pixel.toInt();
      //colorConverter(pixelLong);
      Serial.print("(");
      Serial.print(x);
      Serial.print(", ");
      Serial.print(y);
      Serial.print(") = ");
      Serial.print(pixel);
      Serial.print(" | pixelLong = ");
      //Serial.println(pixelLong);
      matrix.drawPixel(x / 10, y, matrix.Color(redLed, greenLed, blueLed));
      x = 1;
      pixel = "";
    }
    delay(50);
  }
  matrix.show();
  file.rewind();
  file.close();
  }*/

/*void drawImage() {
  const int aWidth = 1280;            // array of text file with image web colors
  byte i;
  char currentChar;
  String webColor;
  file.open("SoftSpi.txt", O_RDWR | O_CREAT);
  for (int y = 1; y <= 8; y++) {
    for (int x = 1; x <= 1280; x++) {
      currentChar = file.read();
      if (currentChar == '\n') {
        currentChar = file.read();
        currentChar = file.read();
      }
      if ((x % 10) <= 8 && (x % 10) != 0) {
        pixel = pixel + currentChar;
      }
      if ((x % 10) == 0) {
        long pixelLong = pixel.toInt();
        colorConverter(pixelLong);
        Serial.print("(");
        Serial.print(x / 10);
        Serial.print(", ");
        Serial.print(y);
        Serial.print(") = ");
        Serial.print(pixel);
        Serial.print(" | pixelLong = ");
        Serial.println(pixelLong);
        matrix.drawPixel(x / 10, y, matrix.Color(redLed, greenLed, blueLed));
        pixel = "";
        delay(25);
      }
    }
  }
  matrix.show();
  file.rewind();
  file.close();
}*/

/*void drawImageSafe(const long image[]) {
  for (int y = 0; y < 8; y++) {
    for (int x = 0; x < 32; x++) {
      colorConverter(pgm_read_dword(&(image [x + 32 * y])));
      matrix.drawPixel(x, y, matrix.Color(redLed, greenLed, blueLed));
    }
  }
  matrix.show();
}*/

void scrollImage(const long image[]) {
  if (hole == true) {
    return;
  }
  for (int t = 0; t < 68 ; t++) {
    for (int y = 0; y < 8; y++) {
      for (int x = 0; x < 63; x++) {
        colorConverter(pgm_read_dword(&(image [x + 64 * (y + t)])));
        matrix.drawPixel(x, y, matrix.Color(redLed, greenLed, blueLed));
      }
      for (int x = 64; x < 127; x++) {
        colorConverter(pgm_read_dword(&(image [x + 64 * (y + t)])));
        matrix.drawPixel(x, y, matrix.Color(redLed, greenLed, blueLed));
      }
    }
    //delay(500);
    matrix.show();
    checkDistance();
    checkButtons();
    if (hole == true) {
      return;
    }
  }
  for (int t = 68; t > 0 ; t--) {
    for (int y = 0; y < 8; y++) {
      for (int x = 0; x < 63; x++) {
        colorConverter(pgm_read_dword(&(image [x + 64 * (y + t - 1)])));
        matrix.drawPixel(x, y, matrix.Color(redLed, greenLed, blueLed));
      }
      for (int x = 64; x < 127; x++) {
        colorConverter(pgm_read_dword(&(image [x + 64 * (y + t - 1)])));
        matrix.drawPixel(x, y, matrix.Color(redLed, greenLed, blueLed));
      }
    }
    matrix.show();
    checkDistance();
    checkButtons();
    if (hole == true) {
      break;
    }
  }
}

void scrollImageRoom(const long image[]) {
  if (hole == false) {
    return;
  }
  for (int t = 0; t < 68 ; t++) {
    for (int y = 0; y < 8; y++) {
      for (int x = 0; x < 63; x++) {
        colorConverter(pgm_read_dword(&(image [x + 64 * (y + t)])));
        matrix.drawPixel(x, y, matrix.Color(redLed, greenLed, blueLed));
      }
      for (int x = 64; x < 127; x++) {
        colorConverter(pgm_read_dword(&(image [x + 64 * (y + t)])));
        matrix.drawPixel(x, y, matrix.Color(redLed, greenLed, blueLed));
      }
    }
    matrix.show();
    calculateTime();
    checkDistance();
    checkButtons();
    if (hole == false) {
      break;
    }
  }
  for (int t = 68; t > 0 ; t--) {
    for (int y = 0; y < 8; y++) {
      for (int x = 0; x < 63; x++) {
        colorConverter(pgm_read_dword(&(image [x + 64 * (y + t)])));
        matrix.drawPixel(x, y, matrix.Color(redLed, greenLed, blueLed));
      }
      for (int x = 64; x < 127; x++) {
        colorConverter(pgm_read_dword(&(image [x + 64 * (y + t - 1)])));
        matrix.drawPixel(x, y, matrix.Color(redLed, greenLed, blueLed));
      }
    }
    matrix.show();
    calculateTime();
    checkDistance();
    checkButtons();
    if (hole == false) {
      break;
    }
  }
}

/*void scrollImageSafe(const long image[]) {
  if (hole == true) {
    return;
  }
  for (int t = 0; t < 31 ; t++) {
    for (int y = 0; y < 8; y++) {
      for (int x = 0; x < 31; x++) {
        colorConverter(pgm_read_dword(&(image [x + 32 * (y + t)])));
        matrix.drawPixel(x, y, matrix.Color(redLed, greenLed, blueLed));
      }
    }
    matrix.show();
    checkDistance();
    checkButtons();
    if (hole == true) {
      break;
    }
  }
  for (int t = 31; t > 0 ; t--) {
    for (int y = 0; y < 8; y++) {
      for (int x = 0; x < 32; x++) {
        colorConverter(pgm_read_dword(&(image [x + 32 * (y + t)])));
        matrix.drawPixel(x, y, matrix.Color(redLed, greenLed, blueLed));
      }
    }
    matrix.show();
    checkDistance();
    checkButtons();
    if (hole == true) {
      break;
    }
  }
  }*/

unsigned long EEPROM_readlong(int address) {        // read unsigned long variable from EEPROM
  unsigned long dword = EEPROM_readint(address);    // reads first 16 bit word
  dword = dword << 16;                              // bit shift for next 16 bits word
  dword = dword | EEPROM_readint(address + 2);      // reads second 16 bit word
  return dword;
}

unsigned int EEPROM_readint(int address)  {         // reads 16 bits
  unsigned int word = word(EEPROM.read(address), EEPROM.read(address + 1));
  return word;
}

void EEPROM_writelong(int address, unsigned long value) { // write unsigned long variable from EEPROM
  //truncate upper part and write lower part into EEPROM
  EEPROM_writeint(address + 2, word(value));        // reads first 16 bit word
  value = value >> 16;                              // bit shift for next 16 bits word
  EEPROM_writeint(address, word(value));            // reads second 16 bit word
}

void EEPROM_writeint(int address, int value)        //write word to EEPROM
{
  EEPROM.write(address, highByte(value));           // writes first byte into EEPROM
  EEPROM.write(address + 1 , lowByte(value));       // writes second byte into EEPROM
}


//#else  // ENABLE_SOFTWARE_SPI_CLASS       // ?
//#error ENABLE_SOFTWARE_SPI_CLASS must be set non-zero in SdFat/SdFatConfig.h
//#endif  //ENABLE_SOFTWARE_SPI_CLASS       //  ?
